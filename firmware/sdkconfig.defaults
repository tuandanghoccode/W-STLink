## firmware/sdkconfig.defaults
```kconfig
# ESP32-S3 SuperMini with 4 MB flash and native USB.
CONFIG_IDF_TARGET="esp32s3"
CONFIG_ESPTOOLPY_FLASHMODE_DIO=y
CONFIG_ESPTOOLPY_FLASHFREQ_40M=y
CONFIG_ESPTOOLPY_FLASHSIZE_4MB=y
CONFIG_ESP_DEFAULT_CPU_FREQ_MHZ_240=y
CONFIG_ESP_CONSOLE_USB_SERIAL_JTAG=y

# Wi-Fi and BLE fit in the larger factory app slot. NVS keeps its offset.
CONFIG_PARTITION_TABLE_SINGLE_APP_LARGE=y
CONFIG_BT_ENABLED=y
CONFIG_BT_NIMBLE_ENABLED=y
CONFIG_BT_NIMBLE_NVS_PERSIST=y
CONFIG_BT_NIMBLE_MAX_CONNECTIONS=1
# CONFIG_BT_NIMBLE_ROLE_CENTRAL is not set
# CONFIG_BT_NIMBLE_ROLE_OBSERVER is not set

# Three-wire SWD with one active CMSIS-DAP TCP session.
CONFIG_ESP_DAP_PRODUCT_ID="STM32 WiFi Debugger (ESP32-S3 SuperMini)"
CONFIG_ESP_DAP_1_TCP_PORT=4441
CONFIG_ESP_DAP_1_SWD_SUPPORTED=y
CONFIG_ESP_DAP_1_GPIO_SWDIO_TMS=4
CONFIG_ESP_DAP_1_GPIO_SWCLK_TCK=5
# CONFIG_ESP_DAP_1_JTAG_SUPPORTED is not set
# CONFIG_ESP_DAP_1_NRESET_SUPPORTED is not set
CONFIG_ESP_DAP_1_LED_NONE=y
# CONFIG_ESP_DAP_2_ENABLED is not set
# CONFIG_ESP_DAP_3_ENABLED is not set
CONFIG_ESP_DAP_IO_PORT_WRITE_CYCLES=23
CONFIG_ESP_DAP_DELAY_SLOW_CYCLES=9
CONFIG_ESP_DAP_TCP_USE_KEEPALIVE=y

# Provision Wi-Fi over USB and save credentials on the device.
CONFIG_ESP_DAP_MANAGE_WIFI=y
CONFIG_ESP_DAP_WIFI_MODE_STA=y
CONFIG_ESP_WIFI_SSID=""
CONFIG_ESP_WIFI_PASSWORD=""
CONFIG_ESP_MAXIMUM_RETRY=20
CONFIG_ESP_DAP_SERIAL_CONSOLE_ENABLED=y
# CONFIG_ESP_DAP_SOCKET_CONSOLE_ENABLED is not set
# CONFIG_ESP_UART_BRIDGE_1_ENABLED is not set
# CONFIG_ESP_UART_BRIDGE_2_ENABLED is not set
# CONFIG_ESP_UART_BRIDGE_3_ENABLED is not set
# CONFIG_ESP_ADC_STREAM_ENABLED is not set
# CONFIG_ESP_GPIO_CONTROL_ENABLED is not set
```
